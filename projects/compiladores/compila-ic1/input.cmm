def fib(n) {
    if n == 1 return 1;
    if n == 2 return 1;

    return fib(n-1)+fib(n-2);
}
def main() {
    a = 10;
    while a {
        print fib(input);
        a = a-1;
    }
    return 0;
}